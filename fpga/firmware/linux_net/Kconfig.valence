## fpga/firmware/linux_net/Kconfig.valence
```kconfig
# SPDX-License-Identifier: GPL-2.0-only
# Appended to a generated copy of the clean upstream top-level Kconfig.

config VALENCE_SOC
	tristate "OpenIon Valence VL100 board identity"
	depends on OF
	select SOC_BUS
	default m
	help
	  Register DT configuration identity on the standard SoC bus.
	  The driver remains an external module, loaded by the Valence rootfs.
	  This is not a silicon revision or serial-number probe.

config VALENCE_CMU
	bool "OpenIon Valence fixed-rate clock framework support"
	depends on OF
	select COMMON_CLK
	default y

config VALENCE_DMA
	bool "OpenIon Valence memcpy DMAengine framework support"
	depends on OF && HAS_DMA
	select DMADEVICES
	select DMA_ENGINE
	select DMA_VIRTUAL_CHANNELS
	default y
	help
	  Link DMAengine helpers into the kernel. The Valence provider itself is
	  supplied as an external module; no implicit upstream source modification.
```

## software/opensbi/defconfig
```kconfig
# Only devices physically present in the I1 R8 PS-DDR bit.
CONFIG_PLATFORM_GENERIC_NAME="Valence I1 PS-DDR"
CONFIG_FDT_SERIAL=y
CONFIG_FDT_SERIAL_UART8250=y
CONFIG_FDT_IRQCHIP=y
CONFIG_FDT_IRQCHIP_PLIC=y
CONFIG_FDT_TIMER=y
CONFIG_FDT_TIMER_MTIMER=y
CONFIG_FDT_IPI=y
CONFIG_FDT_IPI_MSWI=y
# CONFIG_SBI_ECALL_CPPC is not set
# CONFIG_SBI_ECALL_SUSP is not set
# CONFIG_SBI_ECALL_SSE is not set
# CONFIG_SBI_ECALL_MPXY is not set
# CONFIG_SBI_ECALL_DBTR is not set
```
